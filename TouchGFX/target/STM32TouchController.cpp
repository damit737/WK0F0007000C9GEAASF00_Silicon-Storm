/**
  ******************************************************************************
  * File Name          : STM32TouchController.cpp
  ******************************************************************************
  * This file is generated by TouchGFX Generator 4.18.1.
  ******************************************************************************
  * @attention
  *
  * Copyright (c) 2024 STMicroelectronics.
  * All rights reserved.
  *
  * This software is licensed under terms that can be found in the LICENSE file
  * in the root directory of this software component.
  * If no LICENSE file comes with this software, it is provided AS-IS.
  *
  ******************************************************************************
  */

/* USER CODE BEGIN STM32TouchController */

#include <STM32TouchController.hpp>
#include "main.h"

extern "C" I2C_HandleTypeDef hi2c1;


GPIO_InitTypeDef GPIO_InitStruct = {0};

extern Touch_t Touch;
uint32_t resolution_x,resolution_y;
int32_t TEST_X,TEST_Y;
void STM32TouchController::init()
{
    /**
     * Initialize touch controller and driver
     *
     */
	uint8_t Buf[ 10 ];

	HAL_NVIC_DisableIRQ(EXTI3_IRQn);
	GPIO_InitStruct.Pin = CTP_INT_Pin;
	GPIO_InitStruct.Mode = GPIO_MODE_OUTPUT_PP;
	GPIO_InitStruct.Pull = GPIO_NOPULL;
	HAL_GPIO_Init(CTP_INT_GPIO_Port, &GPIO_InitStruct);

	HAL_GPIO_WritePin(CTP_RST_GPIO_Port, CTP_RST_Pin, GPIO_PIN_RESET);
	HAL_GPIO_WritePin(CTP_INT_GPIO_Port, CTP_INT_Pin, GPIO_PIN_RESET);

	HAL_Delay( 20 );
	HAL_GPIO_WritePin(CTP_RST_GPIO_Port, CTP_RST_Pin, GPIO_PIN_SET);
	HAL_Delay( 50 );

	GPIO_InitStruct.Pin = CTP_INT_Pin;
	GPIO_InitStruct.Mode = GPIO_MODE_INPUT;
	GPIO_InitStruct.Pull = GPIO_NOPULL;
	HAL_GPIO_Init(CTP_INT_GPIO_Port, &GPIO_InitStruct);

	HAL_NVIC_SetPriority(EXTI3_IRQn, 5, 0);
	HAL_NVIC_EnableIRQ(EXTI3_IRQn);

	HAL_Delay( 100 );

	HAL_I2C_Mem_Read(&hi2c1,0xBB,0x8048,I2C_MEMADD_SIZE_16BIT,&Buf[0],4,10);
	resolution_y = (Buf[0] & 0xFF) | (((uint16_t)Buf[1]<<8) & 0xFF00);
	resolution_x = (Buf[2] & 0xFF) | (((uint16_t)Buf[3]<<8) & 0xFF00);
}

bool STM32TouchController::sampleTouch(int32_t& x, int32_t& y)
{
    /**
     * By default sampleTouch returns false,
     * return true if a touch has been detected, otherwise false.
     *
     * Coordinates are passed to the caller by reference by x and y.
     *
     * This function is called by the TouchGFX framework.
     * By default sampleTouch is called every tick, this can be adjusted by HAL::setTouchSampleRate(int8_t);
     *
     */
	uint8_t Buf[ 10 ];

	if(Touch.Number >= 1 && Touch.Number <= 10)
	{
		HAL_I2C_Mem_Read(&hi2c1,0xBB,0x814F,I2C_MEMADD_SIZE_16BIT,&Buf[0],5,10);
		TEST_X = (Buf[1] & 0xFF) | ((Buf[2]<<8) & 0xFF00);
		TEST_Y = (Buf[3] & 0xFF) | ((Buf[4]<<8) & 0xFF00);
		x =  TEST_Y;
		y = 1424 - TEST_X;
	}

	if(Touch.Number)
	{
		return true;
	}
	else
	{
		return false;
	}
}

/* USER CODE END STM32TouchController */

/************************ (C) COPYRIGHT STMicroelectronics *****END OF FILE****/
